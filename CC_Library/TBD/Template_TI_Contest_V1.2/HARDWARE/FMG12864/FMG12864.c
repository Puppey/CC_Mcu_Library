#include "FMG12864.h"
#include "LCD_Font.h"
//--------------------------------------------------------- 4线SPI接口 驱动
																		  

u8  graphic1[]=
{

/*--  宽度x高度=128x64  --*/
0xFF,0x01,0x01,0x01,0x01,0x01,0x01,0x01,0x01,0x01,0x01,0x01,0x01,0x01,0x01,0x01,
0x01,0x01,0x01,0x01,0x01,0x01,0x01,0x01,0x01,0x01,0x01,0x01,0x01,0x01,0x01,0x01,
0x01,0x01,0x01,0x01,0x01,0x81,0xC1,0x41,0x41,0x41,0x01,0x01,0x01,0x01,0x01,0x01,
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0x80,0x80,0x80,0x80,0x80,0x80,0x80,0x80,0x80,0x80,0x80,0x80,0x80,0x80,0x80,0xFF,
};

void FMG12864_Init(void)
{
		 GPIO_InitTypeDef  GPIO_InitStructure;

		 RCC_APB2PeriphClockCmd(RCC_APB2Periph_GPIOB, ENABLE);	 

		 GPIO_InitStructure.GPIO_Pin = GPIO_Pin_8|GPIO_Pin_5|GPIO_Pin_6|GPIO_Pin_7;				 
		 GPIO_InitStructure.GPIO_Mode = GPIO_Mode_Out_PP; 		 
		 GPIO_InitStructure.GPIO_Speed = GPIO_Speed_50MHz;		
		 GPIO_Init(GPIOB, &GPIO_InitStructure);					 					 
}

void Uc1701_Init()
{
		 FMG12864_Init();
		 HDReset();
		 delay_ms(100);

		 Write_uc1701_COM(0xe2);		//system reset

		 Write_uc1701_COM(0x2c);		//set power control /boost on
		 Write_uc1701_COM(0x2e);		//set power control /boost on/voltage  regular on
		 Write_uc1701_COM(0x2f);		//set power control /boost on/voltage  regular on/ voltage follower on
			 
		 Write_uc1701_COM(0x25);		//set vlcd resistor ratio 	0x20-->0x27

		 Write_uc1701_COM(0x81);	   //set electronic volume 	设对比度
		 Write_uc1701_COM(0x24);	   //值越大，对比度越高从0x00-0x3f

		 Write_uc1701_COM(0xa2);	   //set lcd bias ratio	 1/65 duty
			 
		 Write_uc1701_COM(0xc8);		//set com directionb--c8/c0
		 Write_uc1701_COM(0xa0);	   // set seg direction  -a1/a0

//      Write_uc1701_COM(0xc0);		//set com directionb--c8/c0
//      Write_uc1701_COM(0xa1);	   // set seg direction  -a1/a0
		 Write_uc1701_COM(0xaf);	   // set display enable


}


void clear_screen(u8 xx)
{
u8 i,j;
for(i=0;i<9;i++)
	{
//		CS0=0;
		Write_uc1701_COM(0xb0+i);
		Write_uc1701_COM(0x10);
		Write_uc1701_COM(0x00);
		for(j=0;j<132;j++)
		{
			Write_uc1701_DISPLAY_DATA_serial_4SPI(xx);
		}
	 }
}

void Display_pic1()
{
	u16 i,j,adressd=0;

	for(i=0;i<4;i++)
	{
//		CS0=0;
		Write_uc1701_COM(0xb4+i);
		Write_uc1701_COM(0x10);
//		Write_uc1701_COM(0x03);
		Write_uc1701_COM(0x01);
		for(j=0;j<128;j++)
		{
			Write_uc1701_DISPLAY_DATA_serial_4SPI(graphic1[adressd]);
			adressd++;
		}
	}
	for(i=0;i<4;i++)
	{
//		CS0=0;
		Write_uc1701_COM(0xb0+i);
	    Write_uc1701_COM(0x10);
//		Write_uc1701_COM(0x03);
		Write_uc1701_COM(0x01);
		for(j=0;j<128;j++)
		{
			Write_uc1701_DISPLAY_DATA_serial_4SPI(graphic1[adressd]);
			adressd++;
		}
	}
} 
//***************************************************************************SPI4
void Write_uc1701_COM(u8 COMDADA_4SPI)
{
	u8 bit8;
	RS=0;
//	CS0=0;
	for(bit8=0;bit8<8;bit8++)
	{
		SCL=0;
		if((COMDADA_4SPI&0x80)==0x80)
		SDI=1;
		else		
		SDI=0;
//		SCL=0;
		SCL=1;
		COMDADA_4SPI=(COMDADA_4SPI<<1);

	}
  //  CS1=1;
			
}

void Write_uc1701_DISPLAY_DATA_serial_4SPI(u8 DADA_4SPI)
{   
	u8 bit8;
	RS=1;
//	CS0=0;				

	for(bit8=0;bit8<8;bit8++)
	{
		SCL=0;
		if((DADA_4SPI&0x80)==0x80)
		SDI=1;
		else
		SDI=0;
		SCL=1;
		DADA_4SPI=(DADA_4SPI<<1);

	}
//	CS1=1;
}

void HDReset()
{
	RSTB=0;
	delay_ms(2);
	RSTB=1;
	delay_ms(4);
}      	


void Set_XY(u16 x,u16 y)
{
	if(y>3)
		y-=4;
	else
		y+=4;
	Write_uc1701_COM(0xb0|y);
	Write_uc1701_COM(0x10|((x&0xf0)>>4));
	Write_uc1701_COM(0x01|(x&0x0f));
}

void LCD_Write_6x8(u8 c)
{
	u8 line;
	c-=32;
	for(line=0;line<6;line++)
		Write_uc1701_DISPLAY_DATA_serial_4SPI(F6x8[c][line]);
}

void LCD_Write_8x16(u8 x,u8 y,u8 c)
{
	u8 line;
	Set_XY(x,y);
	c-=32;
	for(line=0;line<8;line++)
		Write_uc1701_DISPLAY_DATA_serial_4SPI(F8X16[c][line]);
	Set_XY(x,y+1);
	for(line=0;line<8;line++)
		Write_uc1701_DISPLAY_DATA_serial_4SPI(F8X16[c][line+8]);
}

void LCD_Write_Chinese(u8 x,u8 y,u8 c)
{
	u8 line;
	Set_XY(x,y);
	for(line=0;line<16;line++)
		Write_uc1701_DISPLAY_DATA_serial_4SPI(Hzk[c][line]);
	Set_XY(x,y+1);
	for(line=0;line<16;line++)
		Write_uc1701_DISPLAY_DATA_serial_4SPI(Hzk[c][line+16]);
}
